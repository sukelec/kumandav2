/ {
    chosen {
        zmk,kscan = &kscan0;
    };

    kscan0: kscan_direct {
        compatible = "zmk,kscan-gpio-direct";
        label = "KSCAN";
        input-gpios
            = <&gpio0  6 (GPIO_ACTIVE_LOW | GPIO_PULL_UP)> // Buton 1 -> D4
            , <&gpio0  8 (GPIO_ACTIVE_LOW | GPIO_PULL_UP)> // Buton 2 -> D5
            , <&gpio0 17 (GPIO_ACTIVE_LOW | GPIO_PULL_UP)> // Buton 3 -> D6
            , <&gpio0 20 (GPIO_ACTIVE_LOW | GPIO_PULL_UP)> // Buton 4 -> D7
            , <&gpio0 22 (GPIO_ACTIVE_LOW | GPIO_PULL_UP)> // Buton 5 -> D8
            , <&gpio0 24 (GPIO_ACTIVE_LOW | GPIO_PULL_UP)> // Buton 6 -> D9
            , <&gpio1  0 (GPIO_ACTIVE_LOW | GPIO_PULL_UP)> // Buton 7 -> D10
            , <&gpio0 11 (GPIO_ACTIVE_LOW | GPIO_PULL_UP)> // Buton 8 -> D14
            ;
    };
};